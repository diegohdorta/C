## meta-ml/conf/layer.conf
```bitbake
# We have a conf and classes directory, add to BBPATH
BBPATH .= ":${LAYERDIR}"

# We have recipes-* directories, add to BBFILES
BBFILES += "${LAYERDIR}/recipes-*/*/*.bb \
            ${LAYERDIR}/recipes-*/*/*.bbappend"

BBFILE_COLLECTIONS += "meta-ml"
BBFILE_PATTERN_meta-ml = "^${LAYERDIR}/"
BBFILE_PRIORITY_meta-ml = "6"

LAYERDEPENDS_meta-ml = "core"
LAYERSERIES_COMPAT_meta-ml = "sumo rocko"
```
